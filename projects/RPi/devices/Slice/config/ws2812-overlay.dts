/dts-v1/;
/plugin/;

/ {
  compatible = "brcm,bcm2708";

  // disable pwm
  fragment@0 {
    target = <&pwm>;
    __overlay__ {
      status = "disabled";
    };
  };

  fragment@1 {
    target = <&soc>;
    __overlay__ {
      #address-cells = <1>;
      #size-cells = <1>;

      ws2812: ws2812 {
        compatible = "rpi,ws2812";
        pinctrl-names = "default";
        pinctrl-0 = <&pwm0_gpio40>;
        reg = <0x7e20c000 0x100>; /* PWM */
        dmas = <&dma 5>;
        dma-names = "pwm_dma";
        led-en-gpios = <&gpio 43 0>;

        rpi,invert = <1>;
        rpi,num_leds = <25>;

        status = "okay";

      };
    };
  };

  __overrides__ {
    invert =        <&ws2812>,"rpi,invert:0";
    num_leds =      <&ws2812>,"rpi,num_leds:0";
  };
};
