// This file has been taken from:
// https://github.com/tsoliman/Retroflag-GPi-case
//
// Thanks @tsoliman !

/dts-v1/;
/plugin/;

/ {
    compatible = "brcm,bcm2835";

    fragment@0 {
        target = <&gpio>;
        __overlay__ {
            pinctrl-names = "default";
            pinctrl-0 = <&pwm_audio_pins>;
            pwm_audio_pins: pwm_audio_pins {
                brcm,pins = <18 19>;   /* gpio no ('BCM' number) */
                brcm,function = <2 2>; /* 0:in, 1:out, 2: alt5, 3: alt4, 4: alt0, 5: alt1, 6: alt2, 7: alt3 */
                brcm,pull = <0 0>;     /* 2:up 1:down 0:none */
            };
        };
    };
};
